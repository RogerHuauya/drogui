#include <arduinoFFT.h>

arduinoFFT FFT = arduinoFFT(); 

const uint16_t samples = 64;
uint8_t exponent;
float vReal[samples] = {
  -1.206984738114142,
  -0.861430769129782,
  -0.571163708077032,
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   0.632259519578583,
   0.575128661153650
  };
float vImag[samples];

unsigned long time;

void setup()
{
  Serial.begin(115200);
  while(!Serial);
  Serial.println("Ready");
  exponent = FFT.Exponent(samples);
}

void loop()
{
    for (uint16_t i = 0; i < samples; i++){
      vImag[i] = 0; 
    }
    time=millis();
    //FFT.Windowing(vReal, samples, FFT_WIN_TYP_HAMMING, FFT_FORWARD); 
    FFT.Compute(vReal, vImag, samples, exponent, FFT_FORWARD); 
    for(int i = 0; i< samples; i++){
      Serial.print('(');
      Serial.print(vReal[i]);
      Serial.print(',');
      Serial.print(vImag[i]);
      Serial.println(')');
    }
    FFT.ComplexToMagnitude(vReal, vImag, samples); 
    Serial.println("Magnitude");
    for(int i = 0; i< samples/2 + 1; i++){
      //Serial.print('(');
      Serial.print((i>0?2:1)*vReal[i]/samples,6);
      Serial.println(';');
    }
    while(1){};
}
